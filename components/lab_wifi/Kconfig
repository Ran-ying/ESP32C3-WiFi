## components/lab_wifi/Kconfig
```kconfig
menu "Wi-Fi laboratory"
config LAB_AP_SSID
    string "Device SoftAP SSID"
    default "ESP32C3-Auditor"
config LAB_AP_PASSWORD
    string "SoftAP password (8-63 printable ASCII; empty generates a private password in NVS)"
    default ""
config LAB_CHANNEL_MAX
    int "Maximum permitted 2.4 GHz channel at installation site"
    range 11 13
    default 11
    help
        Default 1-11. Set 13 only where the installation site permits 1-13.
        No country entry is required in the web UI. Firmware uses a neutral
        driver code with this explicit manual range.
endmenu
```

## sdkconfig.defaults
```kconfig
CONFIG_IDF_TARGET="esp32c3"
CONFIG_ESPTOOLPY_FLASHSIZE_4MB=y
CONFIG_ESP_CONSOLE_USB_SERIAL_JTAG=y
CONFIG_HTTPD_MAX_REQ_HDR_LEN=1024
CONFIG_HTTPD_MAX_URI_LEN=128
CONFIG_ESP_MAIN_TASK_STACK_SIZE=8192
CONFIG_COMPILER_OPTIMIZATION_SIZE=y
```
